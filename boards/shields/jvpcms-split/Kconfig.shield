## boards/shields/jvpcms-split/Kconfig.shield
```kconfig
config SHIELD_JVPCMS_SPLIT_LEFT
  def_bool $(shields_list_contains,jvpcms-split-left)

config SHIELD_JVPCMS_SPLIT_RIGHT
  def_bool $(shields_list_contains,jvpcms-split-right)
```

## config/boards/shields/jvpcms-split/Kconfig.defconfig
```kconfig
if SHIELD_JVPCMS_SPLIT_LEFT

config ZMK_KEYBOARD_NAME
    default "jvpcms-split"

config ZMK_SPLIT_ROLE_CENTRAL
    default y

endif

if SHIELD_JVPCMS_SPLIT_LEFT || SHIELD_JVPCMS_SPLIT_RIGHT
    
config ZMK_SPLIT
    default y

endif
```

## config/west.yml
```yaml
manifest:
  remotes:
    - name: zmkfirmware
      url-base: https://github.com/zmkfirmware
    - name: nicekeyboards
      url-base: https://github.com/nicekeyboards
    # Additional modules containing boards/shields/custom code can be listed here as well
    # See https://docs.zephyrproject.org/3.2.0/develop/west/manifest.html#projects
  projects:
    - name: zmk
      remote: zmkfirmware
      revision: main
      import: app/west.yml
    - name: nicenano
      remote: nicekeyboards
      revision: main
  self:
    path: config
```
